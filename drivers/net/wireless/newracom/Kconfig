## drivers/net/wireless/newracom/Kconfig
```kconfig
config WLAN_VENDOR_NEWRACOM
	bool "Newracom devices"
	default y
	---help---
	  If you have a wireless card belonging to this class, say Y.

	  Note that the answer to this question doesn't directly affect the
	  kernel: saying N will just cause the configurator to skip all the
	  questions about these cards. If you say Y, you will be asked for
	  your specific card in the following questions.

if WLAN_VENDOR_NEWRACOM

source "drivers/net/wireless/newracom/nrc7292/Kconfig"

endif # WLAN_VENDOR_NEWRACOM
```
